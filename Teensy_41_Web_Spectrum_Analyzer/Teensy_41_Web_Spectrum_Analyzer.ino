// ========================================================================================
// Web Spectrum Analyzer Using Teensy 4.1 
// The graphs (time and frequency domains) are made available via a webpage
// UNVERSIDADE FEDERAL DE UBERLÂNDIA - Faculdade de Engenharia Elétrica
// Subject: DSP-EPS - Prof. Ernane A. A. Coelho - http://lattes.cnpq.br/9183492978798433
// This code is for demonstration purposes only, showing how to perform data acquisition and FFT Calculation using the Teensy 4.1 ADC1 
// Code characteristics:
// - Data acquisition is performed via channel A0 of ADC1 of the Teensy 4.1.
// - A voltage sensor based on a differential amplifier will be connected to channel A0 (ADC1)
// - The acquisition sequence for ADC1 will consist of only 1 channel (A0). 
// - The ADC_ETC trigger will be generated by PIT Channel 0 at 4096.01 Hz. It is not possible to generate a frequency of exactly 4096 Hz using the PIT on the Teensy 4.1.
// - The PIT_TRIGGER0 (XBAR1_IN56) is routed to ADC_ETC_TRIG00 (XBAR1_OUT103) by XBAR
// - The FFT calculation will be performed via the CMSIS-DSP library (Cortex Microcontroller Software Interface Standard). 4096 voltage points will
//   be acquired at a rate of 4096.01 Hz, implying a frequency resolution of 1.0000024Hz. The Hann window function is applied to the signal before the FFT calculation,
//   using a function from the CMSIS-DSP library itself.
// 
// - IMPORTANT CONFIGURATION - Chech the parameters below in Arduino IDE Tools:
//       - Tools → Optimize → Fastest
//       - Tools → CPU Speed → 600 MHz
// Warning: Update the Arduino_CMSIS-DSP library in the Arduino IDE library manager.
//          See https://ernane-aac.github.io/Teensy-4.1--How-to-Configure-the-ADC-System/ for more details on ADC configuration on the Teensy 4.1.
//          See https://ernane-aac.github.io/Teensy-4.1-Sinusoidal-Pulse-Width-Modulation/ for more details on FlexPWM configuration on the Teensy 4.1.    
// ========================================================================================

// HARDWARE CONFIGURATION - Must be placed before any includes
// Force the library to use QNEthernet
#define WEBSOCKETS_USE_ETHERNET true
#define USE_QN_ETHERNET true
#define ARM_MATH_CM7

#include <Arduino.h>
#include <vector>
#include <imxrt.h>
#include "arm_math.h"
#include <QNEthernet.h> // QNEthernet, an lwIP-Based Ethernet Library For Teensy 4.1 by Shawn Silverman => https://github.com/ssilverman/QNEthernet
#include <WebSockets2_Generic.h> // WebSockets2_Generic Library by Khoi Hoang =>  https://github.com/khoih-prog/WebSockets2_Generic
                        // A bridge for the files "QNEthernetClient.h" and "QNEthernetServer.h" was inserted in the folder "Documents\Arduino\Libraries\QNEthernet\src" 
                        //  since the libraries try to find these files in this folder, but in fact  they are in "Documents\Arduino\Libraries\QNEthernet\src\qnethernet"

//Teensy 4.1 Analog Inputs:
//Place AFTER includes to prevent conflicts with Arduino's pin A0
//Teensy Analog Input | Teensy Pin | iMXRT1062 pad | ADC1 IN | ADC2 IN |
#define A0 7      //  |      14    |    AD_B1_02   |   IN7   |   IN7   |
#define A1 8      //  |      15    |    AD_B1_03   |   IN8   |   IN8   |
#define A2 12     //  |      16    |    AD_B1_07   |   IN12  |   IN12  |
#define A3 11     //  |      17    |    AD_B1_06   |   IN11  |   IN11  |
#define A4 6      //  |      18    |    AD_B1_01   |   IN6   |   IN6   |
#define A5 5      //  |      19    |    AD_B1_00   |   IN5   |   IN5   |
#define A6 15     //  |      20    |    AD_B1_10   |   IN15  |   IN15  |
#define A7 0      //  |      21    |    AD_B1_11   |   IN0   |   IN0   |
// - For other channels, see the Teensy 4.1 documentation and Table 66-2, ADC external signals, page 3405,
//   i.MX RT1060 Processor Reference Manual, Rev. 3, 07/2021, NXP Semiconductors.

#define START_SYNC_LEVEL -40
#define TRIGGER_LEVEL -10
#define SYNC_DERIVATIVE 5

// Unique MAC address for your device
byte mac[] = { 0xDE, 0xAD, 0xBE, 0xEF, 0xFE, 0x01 };

using namespace qindesign::network;  // Shortcut to use QNEthernet commands without typing the full namespace every time
using namespace websockets2_generic; // Shortcut for general WebSocket functions
using namespace websockets2_generic::network2_generic; //// Shortcut for underlying network/socket functions

// QNEthernet server 
EthernetServer webServer(80);

//Create the TCP server object first
EthernetTcpServer myTcpServer;
//Pass that object to the WebsocketsServer
WebsocketsServer webSocket(&myTcpServer);
std::vector<websockets2_generic::WebsocketsClient> myClients;

//================================================================================================================================
// --- HTML Stored in Flash ---
//================================================================================================================================
const char index_html[] PROGMEM = R"rawliteral(
<!DOCTYPE html>
<html>
<head>
    <meta charset="UTF-8">
    <title>Teensy 4.1 Dashboard</title>
    <script src="https://cdn.jsdelivr.net/npm/chart.js"></script>
    <script src="https://cdn.jsdelivr.net/npm/hammerjs@2.0.8"></script>
    <script src="https://cdn.jsdelivr.net/npm/chartjs-plugin-zoom@2.0.1"></script>
    
<style>
    body { 
        display: flex; 
        flex-direction: column; 
        align-items: center; 
        font-family: sans-serif; 
        padding: 5px; 
        height: 100vh; 
        margin: 0; 
    }

    /* Combined header row for Title + Controls */
    .chart-header {
        display: flex;
        justify-content: space-between;
        align-items: center;
        width: 100%;
        margin-bottom: 6px;
        flex-wrap: wrap;
        gap: 10px;
    }

    .controls { 
        height: auto; 
        display: flex; 
        flex-wrap: wrap; 
        gap: 6px; 
        align-items: center; 
        background: #f4f4f4; 
        padding: 4px 8px; 
        border-radius: 6px; 
    }

    /* Wrapper converted to flex box so canvas scales dynamically */
    .chart-wrapper { 
        width: 90%; 
        height: 38vh; 
        margin-bottom: 10px; 
        display: flex;
        flex-direction: column;
    }

    canvas { 
        width: 100%; 
        flex: 1; /* Fills remaining space so title never overlaps */
        min-height: 0; 
    }

    h1 { color: darkblue; margin: 5px 0; font-size: 1.5rem; }
    h2 { margin: 0; font-size: 1.0rem; text-align: left; white-space: nowrap; }

   footer {
      width: 90%;          
      margin-top: 5px;    
      padding: 4px 0;
   }

   footer table {
    width: 100%;
    border-collapse: collapse;
   }

   footer td {
      vertical-align: top;
      font-size: 0.75rem;  
      color: #555;
      line-height: 1;   
   }
</style>
</head>
<body>

    <h1>Teensy 4.1 Spectrum Analyzer</h1>
    
    <!-- Global Controls -->
    <div class="controls">
        <button onclick="exportToCSV()">Export CSV</button>
        <button onclick="resetAll()">Reset All Graphs</button>
    </div>

    <div class="chart-wrapper">
      <div class="chart-header">
        <h2>Time-Domain - Voltage (V)</h2>
        <div class="controls" style="font-size: 0.85rem;">
            <span><strong>Graph A:</strong></span>
            <button onclick="resetA()">Reset</button>
            <span>| X:</span>
            <button onclick="applyXA(1)">1x</button>
            <button onclick="applyXA(2)">2x</button>
            <button onclick="applyXA(4)">4x</button>
            <button onclick="applyXA(8)">8x</button>
            <span>| Y: V/div</span>
            <button onclick="applyYA(80)">80</button>
            <button onclick="applyYA(40)">40</button>
            <button onclick="applyYA(20)">20</button>
            <button onclick="applyYA(10)">10</button>
            <button onclick="applyYA(1)">1</button>
        </div>
      </div>
    <canvas id="chartA"></canvas>
  </div>

  <div class="chart-wrapper">
    <div class="chart-header">
        <h2>Frequency-Domain - FFT Analysis - Magnitude (V)</h2>  
        <div class="controls" style="font-size: 0.85rem;">
            <span><strong>Graph B:</strong></span>
            <button onclick="resetB()">Reset</button>
            <span>| X:</span>
            <button onclick="applyXB(1)">1x</button>
            <button onclick="applyXB(2)">2x</button>
            <button onclick="applyXB(4)">4x</button>
            <button onclick="applyXB(8)">8x</button>
            <span>| Y: V/div</span>
            <button onclick="applyYB(80)">80</button>
            <button onclick="applyYB(40)">40</button>
            <button onclick="applyYB(20)">20</button>
            <button onclick="applyYB(10)">10</button>
            <button onclick="applyYB(1)">1</button>
        </div>
    </div>
    <canvas id="chartB"></canvas>
 </div>

<script>
        var fs = 4096.01; var SAMPLES_A = 4096; var SAMPLES_B = 2048;
        var MaxFreq = 2000; 
        
        // Independent state variables for Chart A
        let zoomX_A = 1;
        let scaleY_A = 80;

        // Independent state variables for Chart B
        let zoomX_B = 1;
        let scaleY_B = 80;

        // variables for abscissa scales
        const timeLabels = Array.from({length: SAMPLES_A}, (_, i) => (i * 1000 / fs).toFixed(1));
        const freqLabels = Array.from({length: SAMPLES_B}, (_, i) => (i * fs / SAMPLES_A).toFixed(1));

        // PRE-ALLOCATE arrays to prevent memory fragmentation and GC freezes
        const preallocatedDataA = new Array(SAMPLES_A);
        const preallocatedDataB = new Array(SAMPLES_B);

        // Initialize Chart A (Time in ms)
        var chartA = new Chart(document.getElementById('chartA').getContext('2d'), {
            type: 'line',
            data: { 
                labels: timeLabels, 
                datasets: [{ label: 'Voltage', data: preallocatedDataA, borderColor: 'blue', pointRadius: 0 }] 
            },
            options: {
                responsive: true, maintainAspectRatio: false, animation: false,
                plugins: { legend: { display: false }, zoom: { zoom: { wheel: { enabled: true }, mode: 'xy' }, pan: { enabled: true, mode: 'xy' } } },
                scales: { 
                    x: { type: 'linear', title: { display: true, text: 'Time (ms)' }, min: 0, max: (SAMPLES_A / fs) * 1000, ticks: { count: 11 } }, 
                    y: { min: -5 * 80, max: 5 * 80, ticks: { count: 11 } } 
                }
            }
        });

        // Initialize Chart B (Freq)
        var chartB = new Chart(document.getElementById('chartB').getContext('2d'), {
            type: 'line',
            data: { 
                labels: freqLabels, 
                datasets: [{ label: 'FFT', data: preallocatedDataB, borderColor: 'red', pointRadius: 0 }] 
            },
            options: {
                responsive: true, maintainAspectRatio: false, animation: false,
                plugins: { legend: { display: false }, zoom: { zoom: { wheel: { enabled: true }, mode: 'xy' }, pan: { enabled: true, mode: 'xy' } } },
                scales: { 
                    x: { type: 'linear', title: { display: true, text: 'Frequency (Hz)' }, min: 0, max: MaxFreq, ticks: { count: 11 } }, 
                    y: { min: 0, max: 5 * 80, ticks: { count: 6 } } 
                }
            }
        })

        // Update functions for Chart A
        function updateViewA() {
            chartA.resetZoom('none');
            chartA.zoomScale('x', { min: 0, max: ((SAMPLES_A / fs) * 1000) / zoomX_A }, 'none');
            chartA.zoomScale('y', { min: -(5 * scaleY_A), max: 5 * scaleY_A }, 'none');
            chartA.update('none');
        }

        // Update functions for Chart B
        function updateViewB() {
            chartB.resetZoom('none');
            chartB.zoomScale('x', { min: 0, max: MaxFreq / zoomX_B }, 'none');
            chartB.zoomScale('y', { min: 0, max: 5 * scaleY_B }, 'none');
            chartB.update('none');
        }

        // Action bindings
        function applyXA(factor) { zoomX_A = factor; updateViewA(); }
        function applyYA(val) { scaleY_A = val; updateViewA(); }
        function resetA() { zoomX_A = 1; scaleY_A = 80; updateViewA(); }

        function applyXB(factor) { zoomX_B = factor; updateViewB(); }
        function applyYB(val) { scaleY_B = val; updateViewB(); }
        function resetB() { zoomX_B = 1; scaleY_B = 80; updateViewB(); }

        function resetAll() {
            resetA();
            resetB();
        }

        // Zero-Allocation WebSocket Logic
        var socket = new WebSocket('ws://' + window.location.hostname + ':81/');
        socket.binaryType = 'arraybuffer';
        
        let latestPacket = null;
        let isRendering = false;

        socket.onmessage = function(e) {
            latestPacket = e.data; 

            if (!isRendering) {
                isRendering = true;
                requestAnimationFrame(renderCharts);
            }
        }

        function renderCharts() {
            if (!latestPacket) {
                isRendering = false;
                return;
            }

            var dataView = new Float32Array(latestPacket);
            latestPacket = null; 

            if (dataView.length >= (SAMPLES_A + SAMPLES_B)) {
                // In-place copy: updates existing array elements without creating new memory objects
                for (let i = 0; i < SAMPLES_A; i++) {
                    preallocatedDataA[i] = dataView[i];
                }
                for (let i = 0; i < SAMPLES_B; i++) {
                    preallocatedDataB[i] = dataView[SAMPLES_A + i];
                }
                
                chartA.update('none'); 
                chartB.update('none');
            }

            isRendering = false;
        }

        function exportToCSV() {
            var csvContent = "data:text/csv;charset=utf-8,Time(s),Voltage(V),Frequency(Hz),FFT Magnitude(V)\n";
            for (var i = 0; i < SAMPLES_A; i++) {
                csvContent += `${chartA.data.labels[i]},${chartA.data.datasets[0].data[i]},${(i < SAMPLES_B) ? chartB.data.labels[i] : ""},${(i < SAMPLES_B) ? chartB.data.datasets[0].data[i] : ""}\n`;
            }
            var link = document.createElement("a");
            link.setAttribute("href", encodeURI(csvContent));
            link.setAttribute("download", "teensy_data.csv");
            document.body.appendChild(link);
            link.click();
            document.body.removeChild(link);
        }
    </script>

<footer>
  <table>
     <tr><td>
            <strong>Acknowledgements & Open Source Credits:</strong>        
              <ul>
                 <li><a href="https://www.chartjs.org/" target="_blank" rel="noopener">Chart.js</a> – Open-source HTML5 canvas charting</li>
                 <li><a href="https://hammerjs.github.io/" target="_blank" rel="noopener">Hammer.js</a> – Touch gesture support</li>
                 <li><a href="https://www.chartjs.org/chartjs-plugin-zoom/" target="_blank" rel="noopener">chartjs-plugin-zoom</a> – Zoom and pan capabilities</li>
             </ul>
        </td><td>
            <strong style="color: #008B8B;">Powered by EAAC Systems</strong>
        </td>
   <tr> 
<table>        
</footer>
</body>
</html>
)rawliteral";
//================================================================================================================================
// --- End of HTML page
//================================================================================================================================

//function prototypes
void adc_etc_done0_isr();
void adc_etc_error_isr(); 
void config_XBAR1(void);
void sendHTML(EthernetClient &client);
void FFT_Calculations(void);
void init_PIT0 (void);
void init_ADC1(void);
void ADC1_Calibrate(void);
void init_ADC_ETC(void);
void config_XBAR1(void);
void ADC1_Clear_Coco(void);
void rebootTeensy();
void printArmStatus(arm_status status);

// --- Global variables ---
volatile uint32_t ADC_ETC_Error = 0; // ADC_ETC Error counter
const uint8_t LED_PIN = 13;          // pin of onboard LED
uint16_t LEDcounter;                 // used to blink Onboard LED at 1 Hz

volatile uint16_t k;  // sample counter
// Native CMSIS-DSP functions are limited to a max FFT size of 4096 points (uses pre-compiled tables)
// IMPORTANT: If the `fftSize` constant is changed, don't forget to reconfigure the constants in the HTML code accordingly:
//                         ->  var fs = 4096.01      // Sampling Rate
//                         ->  var SAMPLES_A = 4096  // Time-Domain Size (N)
//                         ->  var SAMPLES_B = 2048; // Frequency-Domain Size (N)
// The sampling rate is base on IPG_Clock :  fs=IPG_Clock/36621=4096.01
const uint16_t fftSize = 4096; 

// =>gain and offset to convert the digital sample into the value of the quantity, in the unit specified during 
//   the multipoint external calibration process (not self-Calibration/internal to the ADC module)
//   gain and offset to convert the digital sample to Volt
const float gain_V = 0.19855;
const float offset_V = -409.0648;
float32_t sample_V;
float32_t moving_avg1, moving_avg2, moving_avg3; //Moving average filter for input signal trigger
float32_t smoothed_voltage, Vk_1, Vk_2; //smoothed samples k, K_1, K_2
float32_t derivative_approx; //derivative approximation for smoothed input signal

// Memory Buffers (aligned for best performance) 
// In Teensy 4.1, float and float32_t are the same. This is important only to maintain the portability of the code, in case it is uploaded to another platform.
float32_t input_aq[fftSize] __attribute__ ((aligned (32)));           // acquired voltage
float32_t input[fftSize] __attribute__ ((aligned (32)));              // input signal to plot in a webpage
float32_t input_w[fftSize] __attribute__ ((aligned (32)));            // fft input vector times Hann window
float32_t window[fftSize] __attribute__ ((aligned (32)));             // Hann window
float32_t output[fftSize] __attribute__ ((aligned (32)));             // complex output
float32_t magnitudes[fftSize / 2] __attribute__ ((aligned (32)));     // fft final result => Single-sided FFT magnitudes (DC to Fs/2-Δf, Δf=Fs/N). The Nyquist bin (Fs/2) is intentionally omitted.
float32_t web_magnitudes[fftSize / 2] __attribute__ ((aligned (32))); // fft final result to show in a webpage
float32_t payload[fftSize + fftSize/2] __attribute__ ((aligned (32)));  // buffer to send values via websocket
float32_t coherentGain;  // Average value of the window coefficients (window coherent gain), computed once in setup()
float32_t scaleFactor;   // FFT magnitude scaling factor that compensates for the FFT normalization and the window coherent gain, yielding the peak amplitude of the input signal

//control variables
volatile uint32_t start;        // Initiates the synchronization process for acquisition
volatile uint32_t sync_signal;  // Start searching for the input signal synchronization point (oscilloscope trigger)
volatile uint32_t FFT_Done;     // Indicates that FFT calculations have been performe
volatile uint32_t sync_timeout_counter; //counter to detect timeout in synchronism process

// Instance declaration of CMSIS structure that holds the configuration and internal tables for the fast real FFT (RFFT) using 32-bit floating point
arm_rfft_fast_instance_f32 fft_instance;

//================================================================================================================================
// ADC_ETC ISR Function 1 (save data)
void adc_etc_done0_isr() {
// - The interrupts done0, done1, and done2 ​​have distinct IRQs (118, 119, and 120). Up to 3 distinct 
//   triggers do not need to share the IRQ, and there is no need to check the call origin flag within the ISR.

    // Read the sequence result in the TRIG0 Result Registers
    uint32_t results = ADC_ETC_TRIG0_RESULT_1_0;  
    uint16_t sample_a = results & 0x0FFF;         // Lower 12 bits  -  chain 0
    sample_V = gain_V * (float32_t) sample_a + offset_V;  // Convert sample to Volt 

    if (k < fftSize) {    //Check that the buffers are not full.
        input_aq[k] = sample_V; //  save sample        
        k++;
       }
    else
      {
       //Note: Synchronization for input signal acquisition is not required for the FFT calculation itself. It is done solely to improve the visualization of the input signal graph. 
       if((sample_V < START_SYNC_LEVEL) && (start==1))
         {
          smoothed_voltage =  sample_V ;
          moving_avg1 = sample_V; 
          moving_avg2 = sample_V; 
          moving_avg3 = sample_V;   
          Vk_2 = smoothed_voltage ;
          Vk_1 = smoothed_voltage;
          start = 0;
          sync_signal = 1;
         }
       if(sync_signal==1)
         {
          smoothed_voltage = (moving_avg1  + moving_avg2 + moving_avg3 + sample_V) / 4;
          moving_avg1 = moving_avg2; 
          moving_avg2 = moving_avg3; 
          moving_avg3 = sample_V;  
          derivative_approx = smoothed_voltage - Vk_2;   
          if(( smoothed_voltage >= TRIGGER_LEVEL)&&(derivative_approx > SYNC_DERIVATIVE))
             { 
              sync_signal = 0;
              k = 0;          //start saving data
              FFT_Done = 0;
             }       
          Vk_2 = Vk_1 ;
          Vk_1 = smoothed_voltage;
         } 
       if ((start == 1)||(sync_signal==1))
         {
            if (sync_timeout_counter > 0)
                 {
                sync_timeout_counter--;
                 }
            else 
                {
                // Timeout expired! Force capture anyway to prevent hanging
                start = 0;
                sync_signal = 0;                
                k = 0; // Force capture start  
                FFT_Done = 0;              
                }      
         }
      }

    LEDcounter++;
    if(LEDcounter>= 2048 )   //toggles the LED state approximately every 0.5s (interrupt frequency = 4096.01 Hz)
           {
             LEDcounter=0;
             digitalWriteFast(LED_PIN,!digitalReadFast(LED_PIN)); // blinks the onboard LED at ~1Hz
           }

    // Clear the Done0 Interrupt Flag for trigger 0 (Write 1 to Clear)
    ADC_ETC_DONE0_1_IRQ = ADC_ETC_DONE0_1_IRQ_TRIG_DONE0(0);

    asm volatile ("dsb");  // Data Synchronization Barrier -> This forces the CPU to wait until the peripheral really clears its interrupt flag,
                           //                                 It prevents the ISR from retriggering due to uncleared interrupt flags.
                           //                                 "volatile" -> Compiler must keep it exactly as written, do not move or remove it.
}

//================================================================================================================================
// ADC_ETC ISR Function 2 (clear error)
void adc_etc_error_isr() 
  {
    ADC_ETC_Error++; //To show that the error condition occurred to the main task

    //Regardless of which trigger (0 or 4) requested the ERR interrupt, this code will clear the coco flags from ADC1. 
    ADC1_Clear_Coco(); //Clear ADC1 Conversion Complete Flags

    // Clear the Trigger 0 ERR Interrupt Flag (Write 1 to Clear)
    ADC_ETC_DONE2_ERR_IRQ = ADC_ETC_DONE2_ERR_IRQ_TRIG_ERR(0);

    asm volatile ("dsb");  // Data Synchronization Barrier -> This forces the CPU to wait until the peripheral really clears its interrupt flag,
                           //                                 It prevents the ISR from retriggering due to uncleared interrupt flags.
                           //                                 "volatile" -> Compiler must keep it exactly as written, do not move or remove it.
  }

///================================================================================================================================
void setup() {
  // In spite of reset value shown in pag. 3200 of i.MX RT1060 Processor Reference Manual, Rev. 3, 07/2021.
  //  the code starts with the Flexpwm timers already in operation. Perhaps, during startup, 
  //  the Arduino code sets the RUN bit in the Master Control Register (MCTRL). It needs confirmation!.  
  FLEXPWM4_MCTRL &= ~FLEXPWM_MCTRL_RUN(1 << 2);   // Stop the counter in FLEXPWM4   
  FLEXPWM4_MCTRL &= ~FLEXPWM_MCTRL_CLDOK(1 << 2); // Clear Load OK for FLEXPWM4-SM2 (just in case...) 

    // **** configure the GPIOs used ****
  digitalWriteFast(LED_PIN,LOW);  // set the desired state before activate the GPIO output
  pinMode(LED_PIN, OUTPUT);       // LED_PIN to output

  // According to the note in page 3407, i.MX RT1060 Processor Reference Manual, Rev. 3, 07/2021, The keeper causes an undesired jump behavior in ADC
  // To avoid the problem, disable keeper before starting ADC
  IOMUXC_SW_PAD_CTL_PAD_GPIO_AD_B1_02 &= ~(1 << 12);  // Disable Keeper for A0 (GPIO_AD_B1_02) - THE CHANNEL A0 WILL BE USED IN THIS EXAMPLE

  Serial.begin(115200);               //The serial port is used solely for debugging purposes. If the code is operating normally, there is no need for the serial connection.
  while (!Serial && millis() < 4000); // Wait for Serial Monitor

  //  Post-Mortem Diagnostics: 
  //  If the Teensy experienced a hardware fault (HardFault, Stack Overflow, etc.), this will print the fault details to the Serial Monitor upon the next reboot.
  if (CrashReport)
    {
     Serial.println(""); 
     Serial.print(CrashReport);
    }

  Serial.println("");
  Serial.println("Teensy 4.1 Web Spectrum Analyzer"); //welcome message

 
  // **** variable initialization ****
  LEDcounter = 0;
  k = fftSize;   // an acquisition will begin when the sample counter is reset in the loop function.
 
  sync_signal = 0;   // wait the start for ssync
  FFT_Done = 1;      // Indicates that FFT calculations have been performe
  moving_avg1 = 0;
  moving_avg2 = 0;
  moving_avg3 = 0; 

    // --- Initialize CMSIS-DSP components ---
  arm_status status=arm_rfft_fast_init_f32(&fft_instance, fftSize);
  printArmStatus(status); //print status descrition to the serial port

  // Generate Hann Window coefficients: 0.5 * (1 - cos(2*pi*i / (N-1)))
  const float32_t delta = (2.0f * (float32_t)PI) / (float32_t)(fftSize - 1); // Pre-calculate the "delta" outside the loop 
                                                                             // It reduces number of division operations - all calculations in float32_t
  for (uint32_t i = 0; i < fftSize; i++) {
    float32_t angle = (float32_t)i * delta;
    window[i] = 0.5f * (1.0f - arm_cos_f32(angle)); // Calculates the window coefficients
  }
  // Calculates the actual coherent gain of the generated window
  arm_mean_f32(window, fftSize, &coherentGain);
  // Scale factor that converts FFT magnitudes directly to peak volts for all non-DC bins
  scaleFactor = 2.0f / ((float32_t)fftSize * coherentGain);

  Serial.println("CMSIS-DSP components were initialized!");

  // --- start ETHERNET connection ---
  Serial.println("Starting Ethernet Connection");
  if (!Ethernet.begin(mac)) 
     {
      Serial.println("Ethernet hardware failed to initialize.");
      rebootTeensy(); 
     }

  // Wait for DHCP handshake confirmation to complete a robust startup
  if (!Ethernet.waitForLocalIP(15000))
     {
      Serial.println("DHCP Timeout: No IP address assigned.");
      rebootTeensy(); 
     }

  Serial.print("IP: ");
  Serial.println(Ethernet.localIP());   

    // Start the standard HTTP Webserver
   Serial.println("Webserver starting..."); 
  webServer.begin();
  
  // Start the WebSocket listener
   Serial.println("Websocket starting..."); 
  webSocket.listen(81); 

  init_ADC1();
  Serial.println("ADC1 was configured!");
  ADC1_Calibrate(); //The subroutine sends the result of the internal calibration to the serial terminal before returning

  init_ADC_ETC();
  Serial.println("ADC_ETC was configured!");
  config_XBAR1();  // Route FlexPWM4_SM2_TRIG0 OR FLEXPWM4_PWM2_OUT_TRIG1 (XBAR1_IN54) to ADC_ETC_TRIG00 (XBAR1_OUT103)
  Serial.println("XBAR1 was configured!");
  init_PIT0();  //starts PIT0 to generate 4096.01 Hz trigger to ADC_ETC
  Serial.println("PIT was configured for ADC_ETC Trigger!");

  // Use DWT_CYCCNT (Data Watchpoint and Trace - Cycle counter) to measure execution time of FFT
  // Enable DWT cycle counter
  ARM_DEMCR |= ARM_DEMCR_TRCENA;
  ARM_DWT_CTRL |= ARM_DWT_CTRL_CYCCNTENA;
  Serial.println("DWT_CYCCNT enabled!");

  Serial.println("");
  Serial.println("Connect the sensor/signal conditioning circuit corresponding to the voltage to be measured to analog input A0");
  Serial.println("WARNING: The Teensy 4.1 pins are not 5V tolerant!");
  Serial.println("");

   sync_timeout_counter = 1000; //wait 0.24 s for synchronim
   start = 1;     // starts the synchronization process for acquisition
}

//================================================================================================================================
void loop() {

  //  Process WebSocket events (polling)
  webSocket.poll(); //Keeps connections alive

  //Check for NEW connections
   if (webSocket.available()) {
        websockets2_generic::WebsocketsClient client = webSocket.accept();
        if (client.available()) {
           myClients.push_back(client);
           Serial.println("New client accepted!");
          }
    }

// Broadcast Data (WebSockets2_Generic style)
  static unsigned long lastUpdate = 0;
  if (millis() - lastUpdate > 1000) {
      // Calculate sizes in bytes
      const size_t inputBytes = fftSize * sizeof(float32_t);
      const size_t magBytes = (fftSize / 2) * sizeof(float32_t);
      const size_t totalBytes = inputBytes + magBytes;

      // Prepare the buffer
      // Note: payload index is in elements, so payload + fftSize 
      // correctly points to the start of the magnitudes area.
      memcpy(payload, input, inputBytes);
      memcpy(payload + fftSize, magnitudes, magBytes);
    
      // Use an iterator to handle potential disconnects safely
      for (auto it = myClients.begin(); it != myClients.end(); ) {
          if (it->available()) {
              it->sendBinary((const char*)payload, totalBytes);
              ++it;
          } else {
              // Remove disconnected clients from the list
              it = myClients.erase(it);
          }
      }
      lastUpdate = millis();
      Serial.println("Broadcast Completed!");
  }

  // Listen for incoming clients (browsers)
  EthernetClient client = webServer.available();
  if (client) {
    bool blank = true;
    while (client.connected()) {
      if (client.available()) {
        char c = client.read();
        if (c == '\n' && blank) { sendHTML(client); break; }
        if (c == '\n') blank = true; else if (c != '\r') blank = false;
      }
    }
    
    // Block until all HTML bytes are verified on the wire
    client.flush(); 
    
    // Safely close the session
    client.stop();
  }

  if((k>=fftSize) && (FFT_Done==0))
   {
      memcpy(input, input_aq, sizeof(input_aq)); //copy aquired values to the input vector
      FFT_Calculations(); // calculates de fft and updates the magnitude vector.
      FFT_Done=1;        //  FFT calculations was done!
      sync_timeout_counter = 1000; //wait 0.24 s for synchronim
      start=1;            //  starts the synchronization process for new acquisition
   }

}

//================================================================================================================================
void sendHTML(EthernetClient &client) {
  client.print("HTTP/1.1 200 OK\r\nContent-Type: text/html\r\nConnection: close\r\n\r\n");

  size_t totalBytes = strlen_P(index_html);
  size_t bytesSent = 0;
  
  // 1460 is the ideal payload size for standard Ethernet TCP/IP (MTU 1500 - headers)
  const size_t chunkSize = 1460; 
  uint8_t buffer[chunkSize];

  while (bytesSent < totalBytes) {
    size_t bytesToRead = totalBytes - bytesSent;
    if (bytesToRead > chunkSize) {
      bytesToRead = chunkSize;
    }

    memcpy_P(buffer, index_html + bytesSent, bytesToRead);

    int written = client.writeFully(buffer, bytesToRead);
    if (written < 0) {
      break; 
    }

    bytesSent += written;
    yield(); //Keep the background network and system tasks running during transmission
  }
}


//================================================================================================================================
void FFT_Calculations() {
  float32_t real, imag;
  uint32_t start;    // used to measure the time execution for fft calulations
  uint32_t fft_time;
  float32_t fft_time_us ; 

  start = ARM_DWT_CYCCNT; // get the counter value at the beginning of calculations

  // Apply windowing to the input signal.
  arm_mult_f32(input, window, input_w, fftSize);

  // Execute the FFT
  // Input is real, output is complex (pairs of real/imaginary)
  // void arm_rfft_fast_f32(arm_rfft_fast_instance_f32 *S, float32_t *p,float32_t *pOut, uint8_t ifftFlag)
  // ifftFlag=0 means Forward FFT (Real → Frequency domain)| ifftFlag=1 means Inverse FFT (Frequency → Time domain)
  arm_rfft_fast_f32(&fft_instance, input_w, output, 0);

   // Calculates the magnitude and converts it to the unit of the input quantity
  magnitudes[0] = fabsf(output[0]) * 0.5f * scaleFactor; // DC component
  for (uint32_t k = 1; k < fftSize / 2; k++)             // Harmonics
   {
    real = output[2 * k];
    imag = output[2 * k + 1];
    arm_sqrt_f32(real * real + imag * imag, &magnitudes[k]);
    magnitudes[k] *= scaleFactor;
   }

   fft_time = ARM_DWT_CYCCNT - start;
   fft_time_us = (float32_t)fft_time / (float32_t)F_CPU_ACTUAL * 1e6;
 
  Serial.print("FFT Time (us): ");
  Serial.println(fft_time_us); 
}

//================================================================================================================================
void init_PIT0 (void) {    // Configure PIT0 of the 4 PIT channels
    //  Set PIT clock source to IPG_CLK (150 MHz)
    CCM_CSCMR1 &= ~CCM_CSCMR1_PERCLK_CLK_SEL;

    // Enable Clock for PIT0 using the macro defined in imxrt.h
    // iMXRT.h definitions: #define CCM_CCGR_OFF        0 ->  00 - Clock is off during all modes. Stop enter hardware handshake is disabled.
    //                      #define CCM_CCGR_ON_RUNONLY 1 ->  01 - Clock is on in run mode, but off in WAIT and STOP modes
    //                                                        10 - Not applicable (Reserved).
    //                      #define CCM_CCGR_ON         3 ->  11 - Clock is on during all modes, except STOP mode  
    CCM_CCGR1 |= CCM_CCGR1_PIT(CCM_CCGR_ON); // Enable IPG Clock for PIT module (CCM_CCGR1, CG6)

    // Disable PIT module first to safely configure MCR-Module Control Register
    PIT_MCR = PIT_MCR_MDIS; 

    // Enable PIT module even in DBG mode
    PIT_MCR = 0x00; // bit1 -> MDIS=0, enables Clock for standard PIT timers 
                    // bit0 -> FRZ=0,  Timers continue to run in Debug mode

    // Configure the TOP of PIT0 counter e Load Value for 4096 Hz from 150 MHz IPG Clock
    // LDVAL = 150 MHz IPG Clock/(TOP+1) => 150000000 / 36621 =  4096.01 Hz
    // TOP = 36620
    PIT_LDVAL0 = 36620;

    // Configure PIT0 control:
    // bit2 -> CHN=0 - Timer is not chained -> When activated, timer n-1 needs to expire before timer n (n is > 0) can decrement by 1.
    // bit1 -> TIE=0 - Timer Interrupt Enable - PIT interrupt is not used in this application
    // bit0 -> TEN=1 - Timer0 is enable
    PIT_TCTRL0 = PIT_TCTRL_TEN; 

    // Note: The PIT was used here because it offers higher resolution (32-bit) compared to the 16-bit resolution of the FlexPWM used
    //       in https://ernane-aac.github.io/Teensy-4.1--How-to-Configure-the-ADC-System/. If the application incorporates a PWM-based converter,
    //       FlexPWM is the recommended choice due to the ability to synchronize sampling with switching, which eliminates switching noise from the data acquisition.
}

//================================================================================================================================
void init_ADC1(void) {
   // Enable Clock for ADC1 using the macro defined in imxrt.h
  CCM_CCGR1 |= CCM_CCGR1_ADC1(CCM_CCGR_ON); // Enable ADC1 Clock -> Bits:17–16 CG8, page 1079, i.MX RT1060 Processor Reference Manual, Rev. 3, 07/2021
  //Even when using the Asynchronous Clock Source as ADC Conversion Clock, it is necessary to enable the clock for the ADC in the Clock Control Module (CCM),
  // because the operation of the peripheral interface (the registers you read and write) is still clocked by the system bus clock (IPG clock).

  // **** Select ADC Conversion Clock ****
  //  Notes:
  //  -> In page 65, i.MX RT1060 Crossover Processors for Consumer Products, Rev. 4, 04/2024, NXP Semiconductors, it is said that the operating frequency
  //     of the ADC module can vary from a minimum of 4 MHz to a maximum of 40 MHz (ADLPC=0, not in low power mode; ADHSC=1, High speed conversion).
  //  -> It is important to keep in mind that there is a relationship between the operating frequency of the ADC and its accuracy, with greater accuracy 
  //     occurring at lower frequencies.
  //  -> Increasing the operating frequency allows for operation at higher sampling rates at the cost of reduced accuracy. This results in a trade-off
  //     that must be adjusted according to the application.
  //  -> ADC Conversion Clock Options (ADICLK): 00 IPG clock
  //                                            01 IPG clock divided by 2
  //                                            10 Reserved
  //                                            11 Asynchronous clock (ADACK)* 
  // * ADC Asynchronous Clock Source: (page 66, i.MX RT1060 Crossover Processors for Consumer Products, Rev. 4, 04/2024, NXP Semiconductors) 
  //   ADHSC=0 -> fADACK = 10 MHz 
  //   ADHSC=1 -> fADACK = 20 MHz

  //  => Change the ADC clock according your application
  //  => IN THIS EXAMPLE, Asynchronous clock (ADACK) will be used, which is a dedicated clock used only by the ADC (20MHz - Divider 1, ADHSC=1 ).
#define ADC1_CLOCK_SOURCE 1  // 0: IPG/2/4 (18.75 MHz) | 1: ADACK (20MHz)   

  ADC1_CFG &= ~(ADC_CFG_ADICLK(3));  // Clear ADICLK (00-> IPG CLK)
  ADC1_CFG &= ~(ADC_CFG_ADIV(3));    // Clear ADIV   (00-> divider=1)

#if (ADC1_CLOCK_SOURCE == 0)          // Option 0: IPG/2
    //the lines below configure ADC Conversion Clk for  18.75 MHz, based on IPG CLK  =>  150MHz/2/4 = 18.75 MHz
  ADC1_CFG |= ADC_CFG_ADICLK(1);     // ADICLK = 01
  ADC1_CFG |= ADC_CFG_ADIV(2);       // ADIV = 10 (Div by 4)
    
#elif (ADC1_CLOCK_SOURCE == 1)        // Option 1: ADACK
  ADC1_GC  |= ADC_GC_ADACKEN;        // Enable the oscillator (ADACKEN) -> Force ADACK oscillator to run continuously (Higher Power Consumption)
                                     //  to reduce the latency of initiating a single or first-continuous conversion
  ADC1_CFG |= ADC_CFG_ADICLK(3);     // ADICLK = 11
  #else
    #error "Invalid ADC_CLOCK_SOURCE selected!"
#endif

  //For a shorter sampling time, use LPC=0 and HSC=1. See page 68, i.MX RT1060 Crossover Processors for Consumer Products, Rev. 4, 04/2024, NXP Semiconductors.
  ADC1_CFG |= ADC_CFG_ADHSC;       // Select high speed conversion (HSC=1)
  ADC1_CFG &= ~(ADC_CFG_ADLPC);    // ADC hard block not in low power mode (LPC=0)

  ADC1_CFG &= ~(ADC_CFG_MODE(3));  // Clear MODE
  ADC1_CFG |= ADC_CFG_MODE(2);     // MODE = 0b10 -> 12-bit conversion

  // Sample time configuration
  ADC1_CFG &= ~(ADC_CFG_ADLSMP);   // LSMP=0 -> Short sample mode
  ADC1_CFG &= ~(ADC_CFG_ADSTS(3)); // Clear STS
  ADC1_CFG |= ADC_CFG_ADSTS(2);    // Set STS=0b10 => Sample period (ADC clocks) = 7 if ADLSMP=0b => 1/20MHz*7= 350ns

  ADC1_CFG |= ADC_CFG_ADTRG;       // Selects Hardware trigger - The ADC_ETC module will be configured to trigger the ADC.
  ADC1_GC &= ~(ADC_GC_ADCO);       // Ensures that the ADC waits for the ADC_ETC trigger (not in continuous conversion mode)

  ADC1_GC &= ~(ADC_GC_AVGE);       // Hardware Average disabled => If Enabled -> configure the number of samples below
  // ADC1_CFG &= ~(ADC_CFG_AVGS(3));  // Clear AVGS  
  // ADC1_CFG |= ADC_CFG_AVGS(2);     // Set AVGS: 0b00 - 4 samples averaged; 0b01 - 8 samples averaged; 0b10 - 16 samples averaged; 0b11 32 samples averaged 

  ADC1_HC0 = 16; // The ADC_ETC will be used to select the channel on trigger0 (slot 0) of ADC1.
                 // See page 3431, i.MX RT1060 Processor Reference Manual, Rev. 3, 07/2021, NXP Semiconductors 
                 // Configure ADCx_HCn for all slots used by ADC_ETC
  
  //Note: Other parameters must be in accordance with the reset condition. If the ADC exhibits improper operation, check the additional configuration
  //      bits in the manual. See more details at https://ernane-aac.github.io/Teensy-4.1--How-to-Configure-the-ADC-System/   
}

//================================================================================================================================
void ADC1_Calibrate(void) {
  // According to the i.MX RT1060 Processor Reference Manual, Rev. 3, 07/2021, NXP Semiconductors, page 3419, the ADC must be calibrated
  // using the exact settings you intend to use in your end application (ADC's clock source and frequency, low power configuration, voltage reference selection,
  // sample time, averaging, and the high speed); therefore, configure the ADC before calling this subroutine.

  uint32_t ADC1_config = ADC1_CFG; //save ADC1 hardware trigger option
  ADC1_CFG &= ~ADC_CFG_ADTRG;      //reset hardware trigger for calibration process,  page 3419, i.MX RT1060 Processor Reference Manual, Rev. 3, 07/2021 

  //  Start Calibration
  ADC1_GC |= ADC_GC_CAL;

  //  Timeout Loop (10ms max)
  volatile uint8_t timeout = 10; 
  while ((ADC1_GC & ADC_GC_CAL) && (timeout > 0)) {
        delay(1); // Wait 1ms 
        timeout--;
  }

  // Calibration Result
  if (timeout == 0)
        {
          Serial.println("Timeout in the ADC1 calibration process!");
        } 
  else if (ADC1_GS & ADC_GS_CALF)   // Check CAL flag
             {
               Serial.println("The ADC1 calibration process failed!");
               ADC1_GS |= ADC_GS_CALF; // Clear the fail flag
             }
       else
             {
               uint32_t cal_code = (ADC1_CAL & 0x0F);
               Serial.println("The ADC1 calibration process was completed successfully!");
               Serial.print("CAL_CODE = ");
               Serial.println(cal_code);
             }
  ADC1_CFG =  ADC1_config; //restore ADC1 hardware trigger option          
}

//================================================================================================================================
void init_ADC_ETC(void) {
  // Using this routine implies that:
  //  - The ADC1 module has been configured for Hardware Triggering;
  //  - ADCH = 0b10000 in ADC_HCn register for external channel selection from ADC_ETC (applied to used triggers)
  //  - The ADC_ETC_TRIG00 signal will be activated, therefore configure an appropriate trigger signal on the XBAR1 module.

  ADC_ETC_CTRL |= ADC_ETC_CTRL_SOFTRST; // software reset
  asm volatile("dsb"); // wait for set SOFTRST bit
  delay(10);           // wait for reset process
  ADC_ETC_CTRL &= ~ADC_ETC_CTRL_SOFTRST; // normal operation
  ADC_ETC_CTRL &= ~ADC_ETC_CTRL_TSC_BYPASS; // NOTE: To use ADC2, this bit should be cleared. 
                                            // See page 3459, i.MX RT1060 Processor Reference Manual, Rev. 3, 07/2021 - NXP Semiconductors
  asm volatile("dsb"); // wait for reset SOFTRST bit
  delay(10);           // wait for normal operation starts  

  ADC1_Clear_Coco(); //Clear ADC1 Conversion Complete Flags - This is a kind of reset of ADC1 (just in case...)        
 
  // Trigger 0 Chain with 1 segment (1 channel for sampling via ADC1) (N+1)
  // Priority does not matter, no other trigger to compete for the ADC's attention.
  // Select Hardware trigger mode
  ADC_ETC_TRIG0_CTRL = ADC_ETC_TRIG_CTRL_TRIG_CHAIN(0); // "0" means 1 item (N+1) -> 1 segment for ADC1

  // Configure the linked Trigger0 
  // Trigger0: Segment 0: ADC1 (HWTS 0), Channel 7 (A0), Interrupt Enabled (IE=01)
  // Interrupt configuration:  00b-No interrupt; 01b-interrupt on Done0; 10b-interrupt on Done1; 11b-interrupt on Done2 
  ADC_ETC_TRIG0_CHAIN_1_0 =                   //Trigger 0 (ADC1) chain configuration
       ADC_ETC_TRIG_CHAIN_B2B0           |    // Back to Back ADC trigger (B2B) is not applied, B2B doesn't matter here because this is the first and only conversion.
       ADC_ETC_TRIG_CHAIN_HWTS0(1 << 0)  |    // LOWER WORD: Target ADC1 Slot 0 (HC0) for first sample
       ADC_ETC_TRIG_CHAIN_CSEL0(A0)      |    //             Sample A0 (Hardware Channel 7)
       ADC_ETC_TRIG_CHAIN_IE0(1)         ;    //             interrupt on Done0 enabled

// IMPORTANT NOTE FOR MULTIPLE CHANNELS IN THE CHAIN (It is not the case in this example):
//                 If B2B is set for all segments of the chain above (except the first), there is no need to configure the sampling interval. 
//                 If B2B = 0 for any segment other than the first, the sampling interval must be adjusted to a delay greater than the total
//                  sampling time (sampling time + conversion time). In this example, we have 1 channel in the chain, so  B2B is not applied (it doesn't matter).
//ADC_ETC_CTRL |= ADC_ETC_CTRL_PRE_DIVIDER(1);   // configure pre_divider = 0 (8-bits) for initial delay and sample interval
//ADC_ETC_TRIG0_COUNTER =   ADC_ETC_TRIG_COUNTER_INIT_DELAY(0) |       // Initial_delay (16-bits) = (INIT_DELAY+1)*(PRE_DIVIDER+1)*ipg_clk
//                          ADC_ETC_TRIG_COUNTER_SAMPLE_INTERVAL(136); // Interval_delay = (SAMPLE_INTERVAL+1)*(PRE_DIVIDER+1)*ipg_clk

  // Install the ISR to IRQ 118 (Done0)
  attachInterruptVector(IRQ_ADC_ETC0, &adc_etc_done0_isr); 
  // Set priority (optional, 128 is default)
  NVIC_SET_PRIORITY(IRQ_ADC_ETC0, 0x80);  // Only the superior nibble is considered => 128=0x80= 1000 0000 => Level 8 out of 15 (16 levels)
    // Enable the IRQ in the Nested Vectored Interrupt Controller
  NVIC_ENABLE_IRQ(IRQ_ADC_ETC0); // Enable the IRQ in NVIC (Nested Vectored Interrupt Controller) => Interrupt at ADC_ETC was enabled above
  
  // Install the ISR to IRQ 121 (TRIG0_ERR)
  attachInterruptVector(IRQ_ADC_ETC_ERR, &adc_etc_error_isr);
  // Set priority (optional)
  NVIC_SET_PRIORITY(IRQ_ADC_ETC_ERR, 0x70);  // Only the superior nibble is considered => 0x70= 0111 0000 => Level 7 out of 15 (16 levels)
  // Enable the IRQ in the Nested Vectored Interrupt Controller
  NVIC_ENABLE_IRQ(IRQ_ADC_ETC_ERR);

  // Configure ADC_ETC Global Control - Enable trigger 0
  ADC_ETC_CTRL |= ADC_ETC_CTRL_TRIG_ENABLE(1 << 0); //Only TRIG00 is enabled:  0x10 - TRIG10; 0x01 - TRIG00  => 0xFF enable all 8 triggers
                                                    //                         0x20 - TRIG11; 0x02 - TRIG01
                                                    //                         0x40 - TRIG12; 0x04 - TRIG02
                                                    //                         0x80 - TRIG13; 0x08 - TRIG03

  //Notes: - Other parameters must be in accordance with the reset condition. 
  //       - TRIGGER sampling interval and initial delay in default values (ETC_TRIG Counter Register)
}

//================================================================================================================================
void config_XBAR1(void){
  // ===== XBAR1 Configuration =====
  CCM_CCGR2 |= CCM_CCGR2_XBAR1(CCM_CCGR_ON); // Enable Clock for XBARA1

  // Route PIT Channel 0 to ADC_ETC Trigger 0 via XBAR1
  // Route PIT_TRIGGER0 (XBAR1_IN56) to ADC_ETC_TRIG00 (XBAR1_OUT103)
  // XBAR1_OUT103 configuration register is XBAR1_SEL51 (high byte controls OUT103)
  // XBARA1_SEL51 handles Output 102 (bits 6:0) and Output 103 (bits 14:8) => number of input in 7-bits
  XBARA1_SEL51 &= ~0x7F00;    // Clear SEL51 (XBAR1_OUT103) upper byte
  XBARA1_SEL51 |= (56<<8);            

}

//================================================================================================================================
void ADC1_Clear_Coco(void) //Clear ADC1 Conversion Complete Flags
{
    //Reset COCO flags - page 3412, i.MX RT1060 Processor Reference Manual, Rev. 3, 07/2021
    volatile uint32_t dummy; 
    dummy = ADC1_R0;
    dummy = ADC1_R1;
    dummy = ADC1_R2;
    dummy = ADC1_R3;
    dummy = ADC1_R4;
    dummy = ADC1_R5;
    dummy = ADC1_R6;
    dummy = ADC1_R7; 
}

//================================================================================================================================
void rebootTeensy() {
  Serial.println("Rebooting in 10 seconds...");
  delay(10000);
  
  // This triggers a system reset
  SCB_AIRCR = 0x05FA0004;
}


//================================================================================================================================
void printArmStatus(arm_status status) {
    Serial.print("CMSIS-DSP Status: ");
    switch (status) {
        case ARM_MATH_SUCCESS:
            Serial.println("ARM_MATH_SUCCESS (No error)");
            break;
        case ARM_MATH_ARGUMENT_ERROR:
            Serial.println("ARM_MATH_ARGUMENT_ERROR (One or more arguments are incorrect)");
            break;
        case ARM_MATH_LENGTH_ERROR:
            Serial.println("ARM_MATH_LENGTH_ERROR (Length of data buffer is incorrect)");
            break;
        case ARM_MATH_SIZE_MISMATCH:
            Serial.println("ARM_MATH_SIZE_MISMATCH (Size of matrices is not compatible)");
            break;
        case ARM_MATH_NANINF:
            Serial.println("ARM_MATH_NANINF (NaN or infinity was generated)");
            break;
        case ARM_MATH_SINGULAR:
            Serial.println("ARM_MATH_SINGULAR (Input matrix is singular)");
            break;
        case ARM_MATH_TEST_FAILURE:
            Serial.println("ARM_MATH_TEST_FAILURE (Test Failed)");
            break;
        default:
            Serial.print("Unknown Status Code: ");
            Serial.println(status);
            break;
    }
}


